## arch/risc-v/src/hpm5300/Kconfig
```kconfig
#
# For a description of the syntax of this configuration file,
# see the file kconfig-language.txt in the NuttX tools repository.
#

comment "HPM5300 Configuration Options"

choice
	prompt "HPM5300 Chip Selection"
	default ARCH_CHIP_HPM5361ICB
	depends on ARCH_CHIP_HPM5300

config ARCH_CHIP_HPM5361ICB
	bool "HPM5361ICB"
	select ARCH_FAMILY_HPM5361

endchoice # HPM5300 Chip Selection

# Keep the chip identity used by the board and register-header selectors.

config ARCH_CHIP_HPM5361
	bool

config ARCH_FAMILY_HPM5300
	bool

config ARCH_FAMILY_HPM5361
	bool
	select ARCH_CHIP_HPM5361
	select ARCH_FAMILY_HPM5300

menu "HPM5300 Peripheral Selection"

menu "DMA controller"

config HPM_HDMA
	bool "HDMA controller"
	default n
	select ARCH_DMA
	select SCHED_WORKQUEUE
	---help---
		Enable the HPM5300 HDMA controller and DMAMUX support.
		The driver provides shared DMA channel management for
		memory transfers and DMA-capable peripherals.

config HPM_HDMA_STOP_TIMEOUT
	int "DMA channel stop timeout (milliseconds)"
	default 100
	range 1 60000
	depends on HPM_HDMA
	---help---
		Maximum wait for a channel to stop after cancellation.
		This is not a timeout for normal transfer completion.

config HPM_HDMA_WORKPRIORITY
	int "DMA completion worker priority"
	default 224
	range 1 255
	depends on HPM_HDMA

config HPM_HDMA_WORKSTACKSIZE
	int "DMA completion worker stack size"
	default 2048
	range 1024 16384
	depends on HPM_HDMA

config HPM_HDMA_MAX_DESCRIPTORS
	int "Maximum descriptors per DMA chain"
	default 64
	range 1 1024
	depends on HPM_HDMA
	---help---
		Bound the number of copied transfer configurations and aligned
		hardware descriptors allocated by one chain setup. Allocations
		are made only in task context and retained until setup replaces
		them or the quiescent channel is freed. No per-channel arrays
		are reserved when this option is increased.

endmenu # DMA Controller

menu "UART Peripherals"

config HPM_UART0
	bool "UART0"
	default n
	select UART0_SERIALDRIVER

config HPM_UART1
	bool "UART1"
	default n
	select UART1_SERIALDRIVER

config HPM_UART2
	bool "UART2"
	default n
	select UART2_SERIALDRIVER

config HPM_UART3
	bool "UART3"
	default n
	select UART3_SERIALDRIVER

config HPM_UART4
	bool "UART4"
	default n
	select UART4_SERIALDRIVER

config HPM_UART5
	bool "UART5"
	default n
	select UART5_SERIALDRIVER

config HPM_UART6
	bool "UART6"
	default n
	select UART6_SERIALDRIVER

config HPM_UART7
	bool "UART7"
	default n
	select UART7_SERIALDRIVER

endmenu # UART Peripherals
menu "SPI Peripherals"

config HPM_SPI
	bool
	default y if HPM_SPI0 || HPM_SPI1 || HPM_SPI2 || HPM_SPI3
	select SPI
	select ARCH_HAVE_SPI_BITORDER

config HPM_SPI0
	bool "SPI0 master"
	default n

config HPM_SPI1
	bool "SPI1 master"
	default n

config HPM_SPI2
	bool "SPI2 master"
	default n

config HPM_SPI3
	bool "SPI3 master"
	default n

config HPM_SPI_TIMEOUT
	int "SPI polling timeout (milliseconds without progress)"
	default 1000
	range 1 60000
	depends on HPM_SPI
	---help---
		Maximum time without FIFO progress, and maximum wait for idle/reset.
		Polling runs in task context with interrupts enabled. This driver
		does not implement SPI slave mode, DMA or deferred DMA triggers.

endmenu # SPI Peripherals
endmenu # HPM5300 Peripheral Selection
```

## boards/risc-v/hpm5300/helixlink/Kconfig
```kconfig
comment "HelixLink V2.0 Board Configuration"

config HELIXLINK_SPIFLASH
	bool "External W25Q128 Flash on SPI1"
	default n
	depends on HPM_SPI1 && BOARD_LATE_INITIALIZE
	depends on !DISABLE_MOUNTPOINT
	select MTD
	select MTD_W25
	---help---
		Probe the external W25Q128JV and register /dev/mtd0 during board
		late initialization. No filesystem is mounted or formatted.
		The nsh defconfig uses W25_READONLY for initial bring-up. Disabling
		W25_READONLY enables normal W25 writes and initialization unprotect.
```
